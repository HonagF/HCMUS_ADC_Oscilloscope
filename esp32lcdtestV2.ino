#include <SPI.h>
#include <TFT_eSPI.h>
#include <driver/spi_slave.h>

TFT_eSPI tft = TFT_eSPI();

// ==========================================
// 1. CẤU HÌNH PHẦN CỨNG
// ==========================================
#define SAMPLES_PER_CH 1024
#define GPIO_MOSI 13
#define GPIO_MISO 12
#define GPIO_SCLK 14
#define GPIO_CS   15

typedef struct __attribute__((packed)) {
    uint8_t header[2]; 
    uint16_t ch1[SAMPLES_PER_CH]; 
    uint16_t ch2[SAMPLES_PER_CH]; 
    uint8_t padding[2]; 
    float vpp1, vpp2, freq1, freq2, vavg1, vavg2, vrms1, vrms2, vamp1, vamp2;
    uint16_t trigger_idx; 
    
    uint8_t hold_flag;    
    uint8_t ch_mode;      
    float y_scale1;        
    float y_scale2;        
    int16_t y_offset1;     
    int16_t y_offset2;     
    
    uint8_t offset_axis; 
    int16_t x_offset1;   
    int16_t x_offset2;   
    uint8_t reset_flag;
    uint8_t footer[2]; 
} Packet_t;

Packet_t rx_packet;
#define PACKET_SIZE sizeof(Packet_t)
WORD_ALIGNED_ATTR uint8_t rx_buf[PACKET_SIZE + 20];

uint16_t prev_y1[385]; 
uint16_t prev_y2[385]; 

// ==========================================
// MẢNG LOGO FETEL
// ==========================================
// 'logo-fetel', 163x40px
const uint16_t fetel_logologo_fetel [] PROGMEM = {
	0x0000, 0x0000, 0x0000, 0x0000, 0x0000, 0x0000, 0x0000, 0x0000, 0x0000, 0x0000, 0x0000, 0x0000, 0x0000, 0x0000, 0x0000, 0x0000, 
	0x0000, 0x0000, 0x0000, 0x0000, 0x0000, 0x0000, 0x0000, 0x0000, 0x0000, 0x0000, 0x0000, 0x0000, 0x0000, 0x0000, 0x0000, 0x0000, 
	0x0000, 0x0000, 0x0000, 0x0000, 0x0000, 0x0000, 0x0000, 0x0000, 0x0000, 0x0000, 0x0000, 0x0000, 0x0000, 0x0000, 0x0000, 0x0000, 
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	0x0000, 0x0000, 0x0000, 0x0000, 0x0000, 0x0000, 0x0000, 0x0000
};

// Array of all bitmaps for convenience. (Total bytes used to store images in PROGMEM = 6544)
const int fetel_logoallArray_LEN = 1;
const uint16_t* fetel_logoallArray[1] = {
	fetel_logologo_fetel
};




// ==========================================
// 3. VẼ KHUNG GIAO DIỆN TĨNH
// ==========================================
void drawStaticUI() {
    tft.fillScreen(TFT_BLACK);
    
    // --- TOP BAR (x:0->480, y:0->39) ---
    // Sẽ in thông số ở Top Bar
    
    // --- KHUNG ĐỒ THỊ (x:0->380, y:40->280) ---
    tft.drawRect(0, 39, 381, 242, TFT_WHITE); // Viền trắng
    // Lưới dọc
    for (int x = 40; x <= 380; x += 40) tft.drawFastVLine(x, 40, 240, 0x2104);
    // Lưới ngang
    for (int y = 40; y <= 280; y += 40) tft.drawFastHLine(0, y, 380, 0x2104);
    tft.drawFastHLine(0, 160, 380, TFT_DARKGREY); // Trục trung tâm (Y=160)

    // --- RIGHT PANEL (x:381->480, y:40->280) ---
    tft.setTextColor(TFT_WHITE, TFT_BLACK);
    tft.setTextFont(2);
    tft.setCursor(385, 45); tft.print(" DualCore ");
    tft.setCursor(385, 65); tft.print("  Scope   ");
    
    // --- BOTTOM BANNER (x:0->480, y:281->320) ---
    tft.drawFastHLine(0, 281, 480, TFT_DARKGREY);
}

void setup() {
    Serial.begin(115200);
    tft.init();
    tft.setRotation(1);
    
    drawStaticUI();

    // Đặt logo ở vị trí X=158 (Căn giữa: (480-164)/2 = 158), Y=281
    tft.setSwapBytes(true);
    tft.pushImage(158, 281, 163, 40, fetel_logologo_fetel);

    spi_bus_config_t buscfg = { .mosi_io_num = GPIO_MOSI, .miso_io_num = GPIO_MISO, .sclk_io_num = GPIO_SCLK, .max_transfer_sz = PACKET_SIZE + 100 };
    spi_slave_interface_config_t slvcfg = { .spics_io_num = GPIO_CS, .queue_size = 3, .mode = 0 };
    spi_slave_initialize(HSPI_HOST, &buscfg, &slvcfg, SPI_DMA_CH_AUTO);
}

void loop() {
    spi_slave_transaction_t t = { .length = PACKET_SIZE * 8, .rx_buffer = rx_buf };
    static uint8_t last_reset_flag = 0;
    
    if (spi_slave_transmit(HSPI_HOST, &t, 10 / portTICK_PERIOD_MS) == ESP_OK) {
        int offset = -1;
        for (int i = 0; i < 15; i++) {
            if (rx_buf[i] == 0xAA && rx_buf[i+1] == 0xBB) { offset = i; break; }
        }

        if (offset != -1) {
            memcpy(&rx_packet, &rx_buf[offset], PACKET_SIZE);
            if (rx_packet.reset_flag == 1 && last_reset_flag == 0) {
                drawStaticUI(); 
                tft.setSwapBytes(true); 
                tft.pushImage(158, 281, 163, 40, fetel_logologo_fetel);

                for (int x = 0; x < 385; x++) {
                    prev_y1[x] = 0;
                    prev_y2[x] = 0;
                }
                Serial.println("Autoset Triggered!");
            }
            
            // Cập nhật trạng thái cũ cho lần lặp sau
           int base_trigger = (int)rx_packet.trigger_idx; 
        
            int start_idx1 = base_trigger + (int)rx_packet.x_offset1;
            int start_idx2 = base_trigger + (int)rx_packet.x_offset2;

            // Giới hạn trong mảng 1024 mẫu
            start_idx1 = constrain(start_idx1, 0, SAMPLES_PER_CH - 381);
            start_idx2 = constrain(start_idx2, 0, SAMPLES_PER_CH - 381);

            float scale1 = rx_packet.y_scale1; if (scale1 <= 0.1f) scale1 = 1.0f;
            int16_t offset1 = rx_packet.y_offset1;
            float scale2 = rx_packet.y_scale2; if (scale2 <= 0.1f) scale2 = 1.0f;
            int16_t offset2 = rx_packet.y_offset2;

            int draw_width = 379; 

            // ==========================================
            // VẼ SÓNG TRONG KHUNG 380x240
            // ==========================================
            for (int x = 0; x < draw_width; x++) {
                // 1. Xóa nét cũ (RÀNG BUỘC CHẶT CHẼ Y=40->280)
                if (prev_y1[x] >= 40 && prev_y1[x+1] >= 40) tft.drawLine(x, prev_y1[x], x + 1, prev_y1[x+1], TFT_BLACK);
                if (prev_y2[x] >= 40 && prev_y2[x+1] >= 40) tft.drawLine(x, prev_y2[x], x + 1, prev_y2[x+1], TFT_BLACK);
                
                // Kẻ lại lưới dọc
                if (x % 40 == 0) tft.drawFastVLine(x, 40, 240, 0x2104);

                // Vẽ CH1 (Xanh lá)
                if ((rx_packet.ch_mode & 0x01) && (start_idx1 + x >= 0) && (start_idx1 + x < SAMPLES_PER_CH - 1)) {
                    int y1 = 160 + ((2048 - rx_packet.ch1[start_idx1 + x]) * 120 / 2048.0) * scale1 + offset1;
                    int y2 = 160 + ((2048 - rx_packet.ch1[start_idx1 + x + 1]) * 120 / 2048.0) * scale1 + offset1;
                    y1 = constrain(y1, 40, 280); y2 = constrain(y2, 40, 280);
                    
                    tft.drawLine(x, y1, x + 1, y2, TFT_GREEN);
                    prev_y1[x] = y1; if (x == draw_width - 1) prev_y1[x+1] = y2;
                } else {
                    prev_y1[x] = 0; if (x == draw_width - 1) prev_y1[x+1] = 0;
                }

                // Vẽ CH2 (Vàng)
                if ((rx_packet.ch_mode & 0x02) && (start_idx2 + x >= 0) && (start_idx2 + x < SAMPLES_PER_CH - 1)) {
                    int y1 = 160 + ((2048 - rx_packet.ch2[start_idx2 + x]) * 120 / 2048.0) * scale2 + offset2;
                    int y2 = 160 + ((2048 - rx_packet.ch2[start_idx2 + x + 1]) * 120 / 2048.0) * scale2 + offset2;
                    y1 = constrain(y1, 40, 280); y2 = constrain(y2, 40, 280);
                    
                    tft.drawLine(x, y1, x + 1, y2, TFT_YELLOW);
                    prev_y2[x] = y1; if (x == draw_width - 1) prev_y2[x+1] = y2;
                } else {
                    prev_y2[x] = 0; if (x == draw_width - 1) prev_y2[x+1] = 0;
                }
            }

            // Dọn rác sóng hụt ở đuôi 
            for(int x = draw_width; x < 379; x++) {
                if (prev_y1[x] >= 40 && prev_y1[x+1] >= 40) tft.drawLine(x, prev_y1[x], x + 1, prev_y1[x+1], TFT_BLACK);
                if (prev_y2[x] >= 40 && prev_y2[x+1] >= 40) tft.drawLine(x, prev_y2[x], x + 1, prev_y2[x+1], TFT_BLACK);
                prev_y1[x] = 0; prev_y2[x] = 0;
                if (x % 40 == 0) tft.drawFastVLine(x, 40, 240, 0x2104);
            }
            prev_y1[379] = 0; prev_y2[379] = 0;

            // Phục hồi lưới ngang
            for (int gy = 40; gy <= 280; gy += 40) tft.drawFastHLine(0, gy, 380, 0x2104);
            tft.drawFastHLine(0, 160, 380, TFT_DARKGREY);

            // ==========================================
            // GIAO DIỆN CHỮ
            // ==========================================
            tft.setTextFont(2);
            tft.setCursor(5, 5);
            if (rx_packet.ch_mode & 0x01) {
                tft.setTextColor(TFT_GREEN, TFT_BLACK);
                tft.printf("CH1: %5.2fV | %4.0fHz | Vavg:%4.2fV ", rx_packet.vpp1, rx_packet.freq1, rx_packet.vavg1);
            } else {
                tft.setTextColor(TFT_DARKGREY, TFT_BLACK); tft.print("CH1: OFF                         ");
            }
            tft.setCursor(5, 22);
            if (rx_packet.ch_mode & 0x01) {
                tft.setTextColor(TFT_GREEN, TFT_BLACK);
                tft.printf("Z1:%3.1fx | X1:%4d               ", rx_packet.y_scale1, rx_packet.x_offset1);
            } else { tft.setTextColor(TFT_BLACK, TFT_BLACK); tft.print("                                 "); }

            tft.setCursor(240, 5);
            if (rx_packet.ch_mode & 0x02) {
                tft.setTextColor(TFT_YELLOW, TFT_BLACK);
                tft.printf("CH2: %5.2fV | %4.0fHz | Vavg:%4.2fV ", rx_packet.vpp2, rx_packet.freq2, rx_packet.vavg2);
            } else {
                tft.setTextColor(TFT_DARKGREY, TFT_BLACK); tft.print("CH2: OFF                         ");
            }
            tft.setCursor(240, 22);
            if (rx_packet.ch_mode & 0x02) {
                tft.setTextColor(TFT_YELLOW, TFT_BLACK);
                tft.printf("Z2:%3.1fx | X2:%4d               ", rx_packet.y_scale2, rx_packet.x_offset2);
            } else { tft.setTextColor(TFT_BLACK, TFT_BLACK); tft.print("                                 "); }

            // RIGHT PANEL
            tft.setCursor(385, 130);
            if (rx_packet.hold_flag == 1) {
                tft.setTextColor(TFT_RED, TFT_BLACK); tft.print(" [STOP]  ");
            } else {
                tft.setTextColor(TFT_GREEN, TFT_BLACK); tft.print(" [RUN]   ");
            }
            tft.setCursor(385, 160);
            tft.setTextColor(TFT_CYAN, TFT_BLACK);
            if (rx_packet.offset_axis == 0) tft.print(" MODE: Y ");
            else tft.print(" MODE: X ");
        }
    }
}